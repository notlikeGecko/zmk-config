## boards/shields/mtest/Kconfig.defconfig
```kconfig
if SHIELD_MTEST

config ZMK_KEYBOARD_NAME
    default "mtest"

endif # SHIELD_MTEST
```

## config/west.yml
```yaml
manifest:
#  defaults:
#  revision: v0.3
  remotes:
    - name: zmkfirmware
      url-base: https://github.com/zmkfirmware
    - name: badjeff
      url-base: https://github.com/badjeff
    - name: notlikeGecko
      url-base: https://github.com/notlikeGecko
  projects:
    - name: zmk
      remote: zmkfirmware
      import: app/west.yml
      revision: main
    - name: zmk-paw3395-driver
      remote: badjeff
      revision: main
    - name: zmk-drv883x-driver
      remote: notlikeGecko
      revision: main
    - name: zmk-input-processor-report-rate-limit
      remote: badjeff
      revision: main
  self:
    path: config
```
