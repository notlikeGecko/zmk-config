
/ {
    behaviors {

    ins883x: behavior_drv883x_0 {
        compatible = "zmk,behavior-drv883x";
        #binding-cells = <2>;

        /* assign a drv883x device */
        drv883x-dev = <&drv883x_0>;

        /* define velocity scope of param2, e.g. range of 265, 128 as neutral point */
        vel-neutral = <128>;
        vel-min-max = <128>;
        // param1: channel = < 0 = IN1/2, 1 = IN3/4 >
        // param2: velocity = < min ... neutral ... max >
    };

};